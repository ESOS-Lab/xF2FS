/*
 * Hisilicon Ltd. Hi3660 SoC
 *
 * Copyright (C) 2014-2016 Hisilicon Ltd.
 *
 * This program is free software; you can redistribute it and/or modify
 * it under the terms of the GNU General Public License version 2 as
 * publishhed by the Free Software Foundation.
 */

/{
			clocks@0 {
				clk_gate_vdec: clk_vdec {
					compatible = "hisilicon,clkdev-dvfs";
					#clock-cells = <0>;
					hisilicon,clk-devfreq-id = <21>;
					/*opp and freq KHz*/
					hisilicon,freq-opp-range = <200000 480000>;
					hisilicon,sensitive-freq = <228000>;
					clock-output-names = "clk_vdec";
					clock-friend-names = "clk_vdecfreq";
				};
			};
};
