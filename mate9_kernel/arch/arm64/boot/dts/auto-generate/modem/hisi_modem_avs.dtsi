/*
 * Hisilicon Ltd.
 *
 * It is only for hisilicon balong modem board. You show change the
 * address of each node according to datasheet.
 */
/*
 *	enum avs_core_type{
 *	AVS_CORE_CCPU = 0,
 * 	AVS_CORE_DSP,
 *	AVS_CORE_BBP,
 *	AVS_CORE_MAX,
 *	};
 */

 / {

	hisi_modem_avs:avs{
		compatible = "hisilicon,avs_balong";
		hisi_avs_regulator_name = "buck4";
		hisi_avs_core_num = <6>;
		hisi_avs_core_type = <0 0 0 0 1 1>;
		hisi_avs_dstfreq = <1066 800 666 533 450 300>;
		hisi_avs_dstvolt = <800 800 700 700 800 700>;
		hisi_avs_maxvolt = <800000 800000 800000 800000 800000 800000>;
		hisi_avs_minvolt = <700000  700000 700000 700000 700000 700000>;
		hisi_avs_target_hpm = <527 527 527 527 0 527>;
		hisi_avs_para_A = <41 41 41 41 41 41>;
		hisi_avs_para_B = <9442 9442 9442 9442 9442 9442>;
		hisi_avs_target_hpmx = <600 600 600 200 600 0>;
		hisi_avs_para_Ax = <41 41 41 41 41 41>;
		hisi_avs_para_Bx = <9442 9442 9442 9442 9442 9442>;
		hisi_avs_volt_num = <10>;
		hisi_avs_volt_list = <700 725 750 775 790 800 810 825 830 850>;
	};
};

