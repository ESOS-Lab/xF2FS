/**
 * Note: any file.dtsi or node in this file will be compile into all config.dts
 *so, if your node or file.dtsi will not use on some products, please don't put it here
 */
/include/ "hisi_3660_clock.dtsi"
/include/ "hisi_3660_hwspinlock.dtsi"
/include/ "hisi_3660_peri_dvfs.dtsi"
/include/ "hisi_3660_peri_dvfs_volt.dtsi"
/include/ "hisi_3660_pm_clk_monitor.dtsi"
/include/ "hisi_3660_ddr.dtsi"
/include/ "hisi_3660_bootdevice.dtsi"
/include/ "hisi_3660_mmc.dtsi"
/include/ "hisi_3660_ufs.dtsi"
/include/ "hisi_3660_ipc.dtsi"
/include/ "hisi_3660_gpio.dtsi"
/include/ "hisi_3660_usb.dtsi"
/include/ "hisi_3660_ion.dtsi"
/include/ "hisi_3660_i2c.dtsi"
/include/ "hisi_3660_gpu.dtsi"
/include/ "hisi_3660_memory.dtsi"
/include/ "hisi_3660_efuse.dtsi"
/include/ "hisi_3660_noc.dtsi"
/include/ "hisi_3660_qos.dtsi"
/include/ "hisi_3660_powerip.dtsi"
/include/ "hisi_freq_autodown.dtsi"
/include/ "hisi_3660_uart.dtsi"
/include/ "hisi_3660_spi.dtsi"
/include/ "hisi_3660_dma.dtsi"
/include/ "hisi_3660_perfstat.dtsi"
/include/ "hisi_3660_trustedcore.dtsi"
/include/ "hisi_3660_mntn.dtsi"
/include/ "hisi_3660_jtag.dtsi"
/include/ "hisi_6421v500_pmic.dtsi"
/include/ "hisi_6421v500_pmic_mntn.dtsi"
/include/ "hisi_3660_syscounter.dtsi"
/include/ "hisi_3660_vdec.dtsi"
/include/ "hisi_3660_venc.dtsi"
/include/ "hisi_3660_lowpm.dtsi"
/include/ "hisi_3660_pmu.dtsi"
/include/ "hisi_3660_camera3.dtsi"
/include/ "huawei-sensor.dtsi"
/include/ "hisi_3660_ddrflux.dtsi"
/include/ "hisi_3660_hisee.dtsi"
/include/ "fastboot_6421v500_mntn.dtsi"
/include/ "hisi_3660_pcie.dtsi"
/include/ "hisi_3660_bl31_kernel_share_mem.dtsi"
/include/ "hisi_3660_ivp.dtsi"
/include/ "hisi_3660_timekeeper.dtsi"
/include/ "hisi_3660_vowifi_proxy.dtsi"

/{
    hisi_flp:flp {
        compatible = "hisilicon,flp-common";
        reg = <0x0 0xfff19000 0x0 0x1000>;
        interrupts = <0x0 0x3a 0x4>;
        clocks = <&clk_gate_timer5>;
        clock-names = "clk_timer5";
        hisi,flp_switch = "on";    /* on/off */
        status = "ok";
    };

};
